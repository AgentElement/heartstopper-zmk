## boards/shields/heartstopper/Kconfig.defconfig
```kconfig
if SHIELD_HEARTSTOPPER_LEFT

config ZMK_KEYBOARD_NAME
    default "Heartstopper"

config ZMK_SPLIT_ROLE_CENTRAL
    default y

endif

if SHIELD_HEARTSTOPPER_LEFT || SHIELD_HEARTSTOPPER_RIGHT

config ZMK_SPLIT
    default y

endif
```

## boards/shields/heartstopper/Kconfig.shield
```kconfig
config SHIELD_HEARTSTOPPER_LEFT
    def_bool $(shields_list_contains,heartstopper_left)

config SHIELD_HEARTSTOPPER_RIGHT
    def_bool $(shields_list_contains,heartstopper_right)
```
